## main/Kconfig.projbuild
```kconfig
menu "Application Configuration"

	menu "GPS UART Setting"

		config UART_RXD_GPIO
			int "GPS RX GPIO number"
			range 1 34
			default 22
			help
				GPIO number (IOxx) for GPS RXD.
				Some GPIOs are used for other purposes (flash connections, etc.) and cannot be used to RXD.
				GPIO 00 assigned as TXD, but not used.

	endmenu

	menu "WiFi Setting"

		choice WIFI_MODE
			prompt "Wi-Fi Access mode"
			default AP_MODE
			help
				Select Wi-Fi Access mode.
			config ST_MODE
				bool "Station MODE"
				help
					Wi-Fi is Station Mode.
			config AP_MODE
				bool "Access Point MODE"
				help
					Wi-Fi is Access Point Mode.
		endchoice

		config ESP_WIFI_SSID
			string "WiFi SSID"
			default "myssid"
			help
				SSID (network name) for the example to connect to.

		config ESP_WIFI_PASSWORD
			string "WiFi Password"
			default "mypassword"
			help
				WiFi password (WPA or WPA2) for the example to use.

		config ESP_MAX_STA_CONN
			depends on AP_MODE
			int "Maximum STA connections"
			default 4
			help
				Max number of the STA connects to AP.

		config ESP_MAXIMUM_RETRY
			depends on ST_MODE
			int "Maximum retry"
			default 5
			help
				Set the Maximum retry to avoid station reconnecting to the AP unlimited when the AP is really inexistent.

		config STATIC_IP
			depends on ST_MODE
			bool "Enable Static IP Address"
			default false
			help
				Enable Static IP Address.

		config STATIC_IP_ADDRESS
			depends on STATIC_IP
			string "Static IP Address"
			default "192.168.10.100"
			help
				Static IP Address for Station.

		config STATIC_GW_ADDRESS
			depends on STATIC_IP
			string "Static GW Address"
			default "192.168.10.1"
			help
				Static GW Address for Station.

		config STATIC_NM_ADDRESS
			depends on STATIC_IP
			string "Static Netmask"
			default "255.255.255.0"
			help
				Static Netmask for Station.

	endmenu

	menu "TCP Server Setting"

		config SERVER_PORT
			int "Port number of TCP Server"
			default 5000
			help
				Port number of TCP Server.
				u-centet connect to this port.

	endmenu

endmenu
```
